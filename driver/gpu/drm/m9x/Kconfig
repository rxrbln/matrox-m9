## driver/gpu/drm/m9x/Kconfig
```kconfig
# SPDX-License-Identifier: GPL-2.0-only

config DRM_M9X
	tristate "Matrox M9/Phoenix clean-room driver"
	depends on DRM && PCI
	select DRM_CLIENT_SELECTION
	select DRM_EXEC
	select DRM_GEM_DMA_HELPER
	select I2C
	select I2C_ALGOBIT
	select DRM_GEM_VRAM_HELPER
	help
	  Independent clean-room bring-up driver for Matrox M9/Phoenix device
	  102b:0540.  It has no dependency on the Parhelia P-series module.

	  m9_enable=1 is required before the driver binds.  It exposes DMA32 GEM
	  and a validate-only command interface.  m9_render_diag=1 is additionally
	  required for the kernel-owned writeback-fence diagnostic.  Guarded warm
	  KMS requires m9_kms=1 and the separately gated direct scanout path
	  requires m9_kms_scanout=1.  m9_triangle_diag=1 permits allocation and
	  synchronous execution of the kernel-owned, vendor-framed first-triangle
	  diagnostic after its cold transitions and sequence-zero setup retire.

	  If compiled as a module, it will be called m9x_drm.

config DRM_M9X_FAA_CONSTANT_SHADER_CONTROL
	bool "Private M9128 FAA public constant shader control"
	depends on DRM_M9X && X86_64
	default n
	help
	  Select the complete independently recovered CREATEPS/SETCONST/SETPS
	  constant-green source profile for the one-shot private FAA diagnostic.
	  Its separately hashed input firmware is
	  m9x/faa-constant-green-known-inputs.bin. This isolates the interpolation
	  setup dependency while preserving the source vertex and raster state.
	  It still requires m9_faa_diag=1 and does not enable application FAA.

config DRM_M9X_FAA_CONSTANT_RED_CONTROL
	bool "Private M9128 FAA public constant red shader control"
	depends on DRM_M9X && X86_64 && !DRM_M9X_FAA_CONSTANT_SHADER_CONTROL
	default n
	help
	  Select the complete independently recovered public CREATEPS/SETCONST/
	  SETPS constant-red source profile with its separate
	  m9x/faa-constant-red-known-inputs.bin firmware. Compared with the green
	  profile this tests shader-color dependence of actual retained stores.
	  It still requires m9_faa_diag=1 and does not enable application FAA.

config DRM_M9X_ORDINARY_SYSTEM_CONTROL
	bool "Private M9128 ordinary SYSTEM constant red control"
	depends on DRM_M9X && X86_64 && !DRM_M9X_FAA_CONSTANT_SHADER_CONTROL
	depends on !DRM_M9X_FAA_CONSTANT_RED_CONTROL
	default n
	help
	  Select the independently recovered ordinary public constant-red draw
	  into a SYSTEM destination, without FAA activation or resolve. Its
	  own input firmware is m9x/ordinary-system-constant-red-known-inputs.bin.
	  This separates output write admission from FAA resolve behavior.
	  It still requires the one-shot m9_faa_diag=1 private diagnostic gates
	  and does not enable application FAA or arbitrary SYSTEM rendering.

choice
	prompt "Private M9128 FAA source phase control"
	depends on DRM_M9X && X86_64 && !DRM_M9X_FAA_CONSTANT_SHADER_CONTROL
	depends on !DRM_M9X_FAA_CONSTANT_RED_CONTROL
	depends on !DRM_M9X_ORDINARY_SYSTEM_CONTROL
	optional
	help
	  Select one independently recovered vendor queue finish instead of the
	  complete output flow. These controls separate initialization, public
	  triangle rendering and subsequent resolve effects. Both are disabled
	  by default. Private diagnostic phases require m9_faa_diag=1 and retain
	  their one-shot gates. The prepared-graph INIT phase instead binds six
	  caller BOs and has no ordinary output or public draw path.

config DRM_M9X_FAA_INIT_ONLY_CONTROL
	bool "After context initialization, before the public triangle"
	help
	  Use the complete initialization-only source profile and separate
	  m9x/faa-init-only-known-inputs.bin firmware. Its real queue finish
	  observes initialization effects without triangle or resolve work.

config DRM_M9X_FAA_GRAPH_INIT_CONTROL
	bool "M9128 prepared graph init source profile"
	help
	  Enable the fresh first-context graph INIT producer for six retained
	  caller-owned BOs. This profile requires its source-known firmware image.

config DRM_M9X_FAA_POST_TRIANGLE_CONTROL
	bool "After the public triangle, before output and resolve"
	help
	  Use the complete post-triangle source profile and separate
	  m9x/faa-post-triangle-known-inputs.bin firmware. Its own counted
	  secondary finish observes draw effects before the output request.

endchoice
```
